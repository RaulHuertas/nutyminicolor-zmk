## boards/shields/nutyminicolor/Kconfig.defconfig
```kconfig
if SHIELD_NUTYMINICOLOR_LEFT

# Name must be less than 16 characters long!
config ZMK_KEYBOARD_NAME
    default "NutyMiniColor"

config ZMK_SPLIT_ROLE_CENTRAL
    default y

endif

if SHIELD_NUTYMINICOLOR_LEFT || SHIELD_NUTYMINICOLOR_RIGHT

config ZMK_SPLIT
    default y

endif
```

## boards/shields/nutyminicolor/Kconfig.shield
```kconfig
# No whitespace after the comma or in your part name!
config SHIELD_NUTYMINICOLOR_LEFT
    def_bool $(shields_list_contains,nutyminicolor_left)

# No whitespace after the comma or in your part name!
config SHIELD_NUTYMINICOLOR_RIGHT
    def_bool $(shields_list_contains,nutyminicolor_right)

# No whitespace after the comma or in the keyboard name!
config SHIELD_NUTYMINICOLOR_DONGLE
    def_bool $(shields_list_contains,nutyminicolor_dongle)
```

## config/west.yml
```yaml
manifest:
  remotes:
    - name: zmkfirmware
      url-base: https://github.com/zmkfirmware
    - name: caksoylar  # 
      url-base: https://github.com/caksoylar  # See https://docs.zephyrproject.org/3.2.0/develop/west/manifest.html#projects
    - name: RaulHuertas
      url-base: https://github.com/RaulHuertas 

  projects:
    - name: zmk
      remote: zmkfirmware
      revision: v0.3
      import: app/west.yml
    - name: zmk-rgbled-widget
      remote: RaulHuertas
      revision: v0.3
  self:
    path: config
```
